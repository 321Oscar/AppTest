/* generated by ASAP2 Studio 2.2.52.10934 */ ASAP2_VERSION 1 40
/begin PROJECT ProjectName ""
/begin MODULE ModuleName ""
/begin MOD_PAR "" /end MOD_PAR
/begin MOD_COMMON "" BYTE_ORDER MSB_FIRST ALIGNMENT_BYTE 1 ALIGNMENT_WORD 2 ALIGNMENT_LONG 4 ALIGNMENT_FLOAT32_IEEE 4 ALIGNMENT_FLOAT64_IEEE 8 /end MOD_COMMON
/begin IF_DATA XCP
 /begin PROTOCOL_LAYER 0x0100 0x07D0 0x2710 0x00 0x00 0x00 0x00 0x00 0x08 0x08 BYTE_ORDER_MSB_FIRST ADDRESS_GRANULARITY_BYTE OPTIONAL_CMD ALLOC_ODT_ENTRY OPTIONAL_CMD ALLOC_ODT OPTIONAL_CMD ALLOC_DAQ OPTIONAL_CMD FREE_DAQ OPTIONAL_CMD GET_DAQ_EVENT_INFO OPTIONAL_CMD GET_DAQ_RESOLUTION_INFO OPTIONAL_CMD GET_DAQ_PROCESSOR_INFO OPTIONAL_CMD GET_DAQ_CLOCK OPTIONAL_CMD START_STOP_SYNCH OPTIONAL_CMD START_STOP_DAQ_LIST OPTIONAL_CMD GET_DAQ_LIST_MODE OPTIONAL_CMD SET_DAQ_LIST_MODE OPTIONAL_CMD WRITE_DAQ OPTIONAL_CMD SET_DAQ_PTR OPTIONAL_CMD CLEAR_DAQ_LIST OPTIONAL_CMD DOWNLOAD OPTIONAL_CMD SHORT_UPLOAD OPTIONAL_CMD UPLOAD OPTIONAL_CMD SET_MTA COMMUNICATION_MODE_SUPPORTED BLOCK SLAVE /end PROTOCOL_LAYER
 /begin DAQ DYNAMIC 0x00 0x02 0x00 OPTIMISATION_TYPE_DEFAULT ADDRESS_EXTENSION_FREE IDENTIFICATION_FIELD_TYPE_ABSOLUTE GRANULARITY_ODT_ENTRY_SIZE_DAQ_BYTE 0xFF NO_OVERLOAD_INDICATION PRESCALER_SUPPORTED /begin TIMESTAMP_SUPPORTED 0x01 SIZE_WORD UNIT_1MS /end TIMESTAMP_SUPPORTED /begin EVENT "10msRstr" "10msRstr" 0x00 DAQ 0x01 0x0A 0x06 0x02 /end EVENT /begin EVENT "100msRstr" "100msRstr" 0x01 DAQ 0x01 0x0A 0x07 0x01 /end EVENT /end DAQ
 /begin PAG 0x00 /end PAG
 /begin PGM PGM_MODE_ABSOLUTE 0x00 0x00 /end PGM
 /begin XCP_ON_CAN 0x0100 CAN_ID_MASTER 0x07AA CAN_ID_SLAVE 0x07AB BAUDRATE 0x07A120 SAMPLE_POINT 0x4B SAMPLE_RATE SINGLE BTL_CYCLES 0x08 SJW 0x02 SYNC_EDGE SINGLE /end XCP_ON_CAN
/end IF_DATA
/begin MEASUREMENT ASW_Core0_1000ms_cnt "" ULONG NO_COMPU_METHOD 0 0 0 4294967295 ECU_ADDRESS 0x52802A5C /end MEASUREMENT
/begin MEASUREMENT ASW_Core0_100ms_cnt "" ULONG NO_COMPU_METHOD 0 0 0 4294967295 ECU_ADDRESS 0x52802A8C /end MEASUREMENT
/begin MEASUREMENT ASW_Core0_10ms_cnt "" ULONG NO_COMPU_METHOD 0 0 0 4294967295 ECU_ADDRESS 0x52802AC0 /end MEASUREMENT
/begin MEASUREMENT ASW_Core0_1ms_cnt "" ULONG NO_COMPU_METHOD 0 0 0 4294967295 ECU_ADDRESS 0x52802AF8 /end MEASUREMENT
/begin MEASUREMENT AdcRealVal.V_DC "" FLOAT32_IEEE NO_COMPU_METHOD 0 0 -3.40282346639E+38 3.40282346639E+38 ECU_ADDRESS 0x52803B38 /end MEASUREMENT
/begin CHARACTERISTIC Cal_CurntCtrl_Ki_d "" VALUE 0x528005D8 __Float32_Value 0 NO_COMPU_METHOD -3.40282346639E+38 3.40282346639E+38 /end CHARACTERISTIC
/begin CHARACTERISTIC Cal_CurntCtrl_Ki_q "" VALUE 0x528005D0 __Float32_Value 0 NO_COMPU_METHOD -3.40282346639E+38 3.40282346639E+38 /end CHARACTERISTIC
/begin CHARACTERISTIC Cal_CurntCtrl_Kp_d "" VALUE 0x528005DC __Float32_Value 0 NO_COMPU_METHOD -3.40282346639E+38 3.40282346639E+38 /end CHARACTERISTIC
/begin CHARACTERISTIC Cal_CurntCtrl_Kp_q "" VALUE 0x528005D4 __Float32_Value 0 NO_COMPU_METHOD -3.40282346639E+38 3.40282346639E+38 /end CHARACTERISTIC
/begin CHARACTERISTIC Cal_RslvOfst "" VALUE 0x5280057C __Float32_Value 0 NO_COMPU_METHOD -3.40282346639E+38 3.40282346639E+38 /end CHARACTERISTIC
/begin MEASUREMENT CurntCtrl.Id_Fb "" FLOAT32_IEEE NO_COMPU_METHOD 0 0 -3.40282346639E+38 3.40282346639E+38 ECU_ADDRESS 0x528027C0 /end MEASUREMENT
/begin MEASUREMENT CurntCtrl.Id_Ref "" FLOAT32_IEEE NO_COMPU_METHOD 0 0 -3.40282346639E+38 3.40282346639E+38 ECU_ADDRESS 0x528027B8 /end MEASUREMENT
/begin MEASUREMENT CurntCtrl.Iq_Fb "" FLOAT32_IEEE NO_COMPU_METHOD 0 0 -3.40282346639E+38 3.40282346639E+38 ECU_ADDRESS 0x528027C4 /end MEASUREMENT
/begin MEASUREMENT CurntCtrl.Iq_Ref "" FLOAT32_IEEE NO_COMPU_METHOD 0 0 -3.40282346639E+38 3.40282346639E+38 ECU_ADDRESS 0x528027BC /end MEASUREMENT
/begin MEASUREMENT CurntCtrl.UdFb "" FLOAT32_IEEE NO_COMPU_METHOD 0 0 -3.40282346639E+38 3.40282346639E+38 ECU_ADDRESS 0x5280285C /end MEASUREMENT
/begin MEASUREMENT CurntCtrl.UqFb "" FLOAT32_IEEE NO_COMPU_METHOD 0 0 -3.40282346639E+38 3.40282346639E+38 ECU_ADDRESS 0x52802858 /end MEASUREMENT
/begin MEASUREMENT CurntCtrl.UsOutFlt "" FLOAT32_IEEE NO_COMPU_METHOD 0 0 -3.40282346639E+38 3.40282346639E+38 ECU_ADDRESS 0x52802854 /end MEASUREMENT
/begin CHARACTERISTIC DebugCAN.CtrlMode "" VALUE 0x528010DD __UByte_Value 0 NO_COMPU_METHOD 0 255 /end CHARACTERISTIC
/begin CHARACTERISTIC DebugCAN.Enable "" VALUE 0x528010DC __UByte_Value 0 NO_COMPU_METHOD 0 255 /end CHARACTERISTIC
/begin CHARACTERISTIC DebugCAN.IsCMD "" VALUE 0x528010D4 __Float32_Value 0 NO_COMPU_METHOD -3.40282346639E+38 3.40282346639E+38 /end CHARACTERISTIC
/begin CHARACTERISTIC DebugCAN.ThetaCMD "" VALUE 0x528010D8 __Float32_Value 0 NO_COMPU_METHOD -3.40282346639E+38 3.40282346639E+38 /end CHARACTERISTIC
/begin MEASUREMENT ErrorCheck.Out_U8_12VLowerWarn "" UBYTE NO_COMPU_METHOD 0 0 0 255 ECU_ADDRESS 0x5280216F /end MEASUREMENT
/begin MEASUREMENT ErrorCheck.Out_U8_12VOverWarn "" UBYTE NO_COMPU_METHOD 0 0 0 255 ECU_ADDRESS 0x5280216C /end MEASUREMENT
/begin MEASUREMENT ErrorCheck.Out_U8_5VLowerWarn "" UBYTE NO_COMPU_METHOD 0 0 0 255 ECU_ADDRESS 0x52802171 /end MEASUREMENT
/begin MEASUREMENT ErrorCheck.Out_U8_5VOverWarn "" UBYTE NO_COMPU_METHOD 0 0 0 255 ECU_ADDRESS 0x52802170 /end MEASUREMENT
/begin MEASUREMENT ErrorCheck.Out_U8_BlockFault "" UBYTE NO_COMPU_METHOD 0 0 0 255 ECU_ADDRESS 0x528021A0 /end MEASUREMENT
/begin MEASUREMENT ErrorCheck.Out_U8_BlockWarn "" UBYTE NO_COMPU_METHOD 0 0 0 255 ECU_ADDRESS 0x52802177 /end MEASUREMENT
/begin MEASUREMENT ErrorCheck.Out_U8_Can0B6LostMsgFault "" UBYTE NO_COMPU_METHOD 0 0 0 255 ECU_ADDRESS 0x52802136 /end MEASUREMENT
/begin MEASUREMENT ErrorCheck.Out_U8_Can0B6TimeOutFault "" UBYTE NO_COMPU_METHOD 0 0 0 255 ECU_ADDRESS 0x5280214B /end MEASUREMENT
/begin MEASUREMENT ErrorCheck.Out_U8_Can100InvalidFault "" UBYTE NO_COMPU_METHOD 0 0 0 255 ECU_ADDRESS 0x52802144 /end MEASUREMENT
/begin MEASUREMENT ErrorCheck.Out_U8_Can100LostMsgFault "" UBYTE NO_COMPU_METHOD 0 0 0 255 ECU_ADDRESS 0x52802135 /end MEASUREMENT
/begin MEASUREMENT ErrorCheck.Out_U8_Can100TimeOutFault "" UBYTE NO_COMPU_METHOD 0 0 0 255 ECU_ADDRESS 0x5280214C /end MEASUREMENT
/begin MEASUREMENT ErrorCheck.Out_U8_Can1BusOffFault "" UBYTE NO_COMPU_METHOD 0 0 0 255 ECU_ADDRESS 0x5280214F /end MEASUREMENT
/begin MEASUREMENT ErrorCheck.Out_U8_Can2BusOffFault "" UBYTE NO_COMPU_METHOD 0 0 0 255 ECU_ADDRESS 0x5280214E /end MEASUREMENT
/begin MEASUREMENT ErrorCheck.Out_U8_CoolerTempOverWarn "" UBYTE NO_COMPU_METHOD 0 0 0 255 ECU_ADDRESS 0x52802173 /end MEASUREMENT
/begin MEASUREMENT ErrorCheck.Out_U8_CoolerTempSenorFault "" UBYTE NO_COMPU_METHOD 0 0 0 255 ECU_ADDRESS 0x52802174 /end MEASUREMENT
/begin MEASUREMENT ErrorCheck.Out_U8_CrashFault "" UBYTE NO_COMPU_METHOD 0 0 0 255 ECU_ADDRESS 0x528021A1 /end MEASUREMENT
/begin MEASUREMENT ErrorCheck.Out_U8_CurrSenFaultAll "" UBYTE NO_COMPU_METHOD 0 0 0 255 ECU_ADDRESS 0x528020EC /end MEASUREMENT
/begin MEASUREMENT ErrorCheck.Out_U8_CurrSenUPhFault "" UBYTE NO_COMPU_METHOD 0 0 0 255 ECU_ADDRESS 0x528020ED /end MEASUREMENT
/begin MEASUREMENT ErrorCheck.Out_U8_CurrSenVPhFault "" UBYTE NO_COMPU_METHOD 0 0 0 255 ECU_ADDRESS 0x52802179 /end MEASUREMENT
/begin MEASUREMENT ErrorCheck.Out_U8_CurrSenWPhFault "" UBYTE NO_COMPU_METHOD 0 0 0 255 ECU_ADDRESS 0x52802178 /end MEASUREMENT
/begin MEASUREMENT ErrorCheck.Out_U8_DrvPBCCurrLowWarn "" UBYTE NO_COMPU_METHOD 0 0 0 255 ECU_ADDRESS 0x5280215D /end MEASUREMENT
/begin MEASUREMENT ErrorCheck.Out_U8_DrvPBCCurrOverWarn "" UBYTE NO_COMPU_METHOD 0 0 0 255 ECU_ADDRESS 0x5280215C /end MEASUREMENT
/begin MEASUREMENT ErrorCheck.Out_U8_HWCurrPHOverFault "" UBYTE NO_COMPU_METHOD 0 0 0 255 ECU_ADDRESS 0x52802131 /end MEASUREMENT
/begin MEASUREMENT ErrorCheck.Out_U8_HWDeadFault "" UBYTE NO_COMPU_METHOD 0 0 0 255 ECU_ADDRESS 0x52802132 /end MEASUREMENT
/begin MEASUREMENT ErrorCheck.Out_U8_HWFoBFault "" UBYTE NO_COMPU_METHOD 0 0 0 255 ECU_ADDRESS 0x52802134 /end MEASUREMENT
/begin MEASUREMENT ErrorCheck.Out_U8_HWFoTFault "" UBYTE NO_COMPU_METHOD 0 0 0 255 ECU_ADDRESS 0x52802133 /end MEASUREMENT
/begin MEASUREMENT ErrorCheck.Out_U8_HWRdcFault "" UBYTE NO_COMPU_METHOD 0 0 0 255 ECU_ADDRESS 0x528020C0 /end MEASUREMENT
/begin MEASUREMENT ErrorCheck.Out_U8_HWVoltLowerFault "" UBYTE NO_COMPU_METHOD 0 0 0 255 ECU_ADDRESS 0x5280212F /end MEASUREMENT
/begin MEASUREMENT ErrorCheck.Out_U8_HWVoltOverFault "" UBYTE NO_COMPU_METHOD 0 0 0 255 ECU_ADDRESS 0x52802130 /end MEASUREMENT
/begin MEASUREMENT ErrorCheck.Out_U8_IgbtEstimTempOverWarn "" UBYTE NO_COMPU_METHOD 0 0 0 255 ECU_ADDRESS 0x52802110 /end MEASUREMENT
/begin MEASUREMENT ErrorCheck.Out_U8_IgbtTemSenFaultAll "" UBYTE NO_COMPU_METHOD 0 0 0 255 ECU_ADDRESS 0x528021A7 /end MEASUREMENT
/begin MEASUREMENT ErrorCheck.Out_U8_IgbtTempOverWarn "" UBYTE NO_COMPU_METHOD 0 0 0 255 ECU_ADDRESS 0x52802175 /end MEASUREMENT
/begin MEASUREMENT ErrorCheck.Out_U8_McuTempOverFault "" UBYTE NO_COMPU_METHOD 0 0 0 255 ECU_ADDRESS 0x5280215E /end MEASUREMENT
/begin MEASUREMENT ErrorCheck.Out_U8_MotTemSenWarn "" UBYTE NO_COMPU_METHOD 0 0 0 255 ECU_ADDRESS 0x52802199 /end MEASUREMENT
/begin MEASUREMENT ErrorCheck.Out_U8_MotTemSenWarnAll "" UBYTE NO_COMPU_METHOD 0 0 0 255 ECU_ADDRESS 0x52802198 /end MEASUREMENT
/begin MEASUREMENT ErrorCheck.Out_U8_OPFault "" UBYTE NO_COMPU_METHOD 0 0 0 255 ECU_ADDRESS 0x52802108 /end MEASUREMENT
/begin MEASUREMENT ErrorCheck.Out_U8_SpdOverWarn "" UBYTE NO_COMPU_METHOD 0 0 0 255 ECU_ADDRESS 0x52802176 /end MEASUREMENT
/begin MEASUREMENT ErrorCheck.Out_U8_VcuSpdCmdWarn "" UBYTE NO_COMPU_METHOD 0 0 0 255 ECU_ADDRESS 0x5280212E /end MEASUREMENT
/begin MEASUREMENT ErrorCheck.Out_U8_VcuTroqCmdWarn "" UBYTE NO_COMPU_METHOD 0 0 0 255 ECU_ADDRESS 0x52802138 /end MEASUREMENT
/begin MEASUREMENT ErrorCheck.Out_U8_VextsLowerWarn "" UBYTE NO_COMPU_METHOD 0 0 0 255 ECU_ADDRESS 0x5280216D /end MEASUREMENT
/begin MEASUREMENT ErrorCheck.Out_U8_VextsOverWarn "" UBYTE NO_COMPU_METHOD 0 0 0 255 ECU_ADDRESS 0x5280216E /end MEASUREMENT
/begin MEASUREMENT ErrorCheck.Out_U8_VoltLowerWarn "" UBYTE NO_COMPU_METHOD 0 0 0 255 ECU_ADDRESS 0x528021A3 /end MEASUREMENT
/begin MEASUREMENT ErrorCheck.Out_U8_VoltOverFault "" UBYTE NO_COMPU_METHOD 0 0 0 255 ECU_ADDRESS 0x528021A4 /end MEASUREMENT
/begin MEASUREMENT ErrorCheck.Out_U8_VoltSuperLower "" UBYTE NO_COMPU_METHOD 0 0 0 255 ECU_ADDRESS 0x528021A2 /end MEASUREMENT
/begin MEASUREMENT ErrorCheck.Out_U8_VoltSuperOverFault "" UBYTE NO_COMPU_METHOD 0 0 0 255 ECU_ADDRESS 0x528021A5 /end MEASUREMENT
/begin MEASUREMENT ErrorCheck.Out_UT8_0NMFlag "" UBYTE NO_COMPU_METHOD 0 0 0 255 ECU_ADDRESS 0x5280211C /end MEASUREMENT
/begin MEASUREMENT ErrorCheck.Out_UT8_ASCTFlag "" UBYTE NO_COMPU_METHOD 0 0 0 255 ECU_ADDRESS 0x5280211A /end MEASUREMENT
/begin MEASUREMENT ErrorCheck.Out_UT8_DisIGBTFlag "" UBYTE NO_COMPU_METHOD 0 0 0 255 ECU_ADDRESS 0x52802119 /end MEASUREMENT
/begin MEASUREMENT ErrorCheck.Out_UT8_ErrLevel "" UBYTE NO_COMPU_METHOD 0 0 0 255 ECU_ADDRESS 0x52802118 /end MEASUREMENT
/begin MEASUREMENT ErrorCheck.Out_UT8_LimSpeedTorFlag "" UBYTE NO_COMPU_METHOD 0 0 0 255 ECU_ADDRESS 0x5280211E /end MEASUREMENT
/begin MEASUREMENT ErrorCheck.Out_UT8_LimTorFlag "" UBYTE NO_COMPU_METHOD 0 0 0 255 ECU_ADDRESS 0x5280211D /end MEASUREMENT
/begin MEASUREMENT ErrorCheck.Out_UT8_MotorTempWarnBeginLimit "" UBYTE NO_COMPU_METHOD 0 0 0 255 ECU_ADDRESS 0x52802101 /end MEASUREMENT
/begin MEASUREMENT ErrorCheck.Out_UT8_MultiOverCurrentFault "" UBYTE NO_COMPU_METHOD 0 0 0 255 ECU_ADDRESS 0x52802100 /end MEASUREMENT
/begin CHARACTERISTIC EventFrame.Switcher "" VALUE 0x528010D2 __UByte_Value 0 NO_COMPU_METHOD 0 255 /end CHARACTERISTIC
/begin MEASUREMENT MtrCalib.IdSet "" FLOAT32_IEEE NO_COMPU_METHOD 0 0 -3.40282346639E+38 3.40282346639E+38 ECU_ADDRESS 0x528110CC /end MEASUREMENT
/begin MEASUREMENT MtrCalib.IqSet "" FLOAT32_IEEE NO_COMPU_METHOD 0 0 -3.40282346639E+38 3.40282346639E+38 ECU_ADDRESS 0x528110D0 /end MEASUREMENT
/begin MEASUREMENT MtrCalib.ThtSetReal "" FLOAT32_IEEE NO_COMPU_METHOD 0 0 -3.40282346639E+38 3.40282346639E+38 ECU_ADDRESS 0x528110E0 /end MEASUREMENT
/begin MEASUREMENT StateMachineStruct.Out_U16_State "" UWORD NO_COMPU_METHOD 0 0 0 65535 ECU_ADDRESS 0x52802678 /end MEASUREMENT
/begin CHARACTERISTIC TestID_Struct.Test_ID_7AF_Spdloop_Towing_Platform "" VALUE 0x52801112 __UByte_Value 0 NO_COMPU_METHOD 0 255 /end CHARACTERISTIC
/begin MEASUREMENT UserCAN0_TxMSG.RMCU_0CB_RollingCounter "" UBYTE NO_COMPU_METHOD 0 0 0 255 ECU_ADDRESS 0x52801A66 /end MEASUREMENT
/begin MEASUREMENT UserCAN0_TxMSG.RMCU_120_RollingCounter "" UBYTE NO_COMPU_METHOD 0 0 0 255 ECU_ADDRESS 0x52801A6B /end MEASUREMENT
/begin MEASUREMENT UserCAN0_TxMSG.RMCU_ActualTorqueFB "" FLOAT32_IEEE NO_COMPU_METHOD 0 0 -3.40282346639E+38 3.40282346639E+38 ECU_ADDRESS 0x52801A58 /end MEASUREMENT
/begin MEASUREMENT UserCAN0_TxMSG.RMCU_DrvMotorInletTemp "WaterTemp" FLOAT32_IEEE NO_COMPU_METHOD 0 0 -3.40282346639E+38 3.40282346639E+38 ECU_ADDRESS 0x52801A78 /end MEASUREMENT
/begin MEASUREMENT UserCAN0_TxMSG.RMCU_DrvMotorRPM "" FLOAT32_IEEE NO_COMPU_METHOD 0 0 -3.40282346639E+38 3.40282346639E+38 ECU_ADDRESS 0x52801A50 /end MEASUREMENT
/begin MEASUREMENT UserCAN0_TxMSG.RMCU_DrvMotorTemp "MotorTempMax" FLOAT32_IEEE NO_COMPU_METHOD 0 0 -3.40282346639E+38 3.40282346639E+38 ECU_ADDRESS 0x52801A8C /end MEASUREMENT
/begin MEASUREMENT UserCAN0_TxMSG.RMCU_DrvMotorWorkSts "" UBYTE NO_COMPU_METHOD 0 0 0 255 ECU_ADDRESS 0x52801A5F /end MEASUREMENT
/begin MEASUREMENT UserCAN0_TxMSG.RMCU_MainWireVolt "" FLOAT32_IEEE NO_COMPU_METHOD 0 0 -3.40282346639E+38 3.40282346639E+38 ECU_ADDRESS 0x52801A88 /end MEASUREMENT
/begin MEASUREMENT UserCAN0_TxMSG.RMCU_MaxTorqueAllow "" FLOAT32_IEEE NO_COMPU_METHOD 0 0 -3.40282346639E+38 3.40282346639E+38 ECU_ADDRESS 0x52801A70 /end MEASUREMENT
/begin MEASUREMENT UserCAN0_TxMSG.RMCU_Temp "IgbtTempMax" FLOAT32_IEEE NO_COMPU_METHOD 0 0 -3.40282346639E+38 3.40282346639E+38 ECU_ADDRESS 0x52801A7C /end MEASUREMENT
/begin MEASUREMENT UserCAN0_TxMSG.RMCU_Us_Out "" FLOAT32_IEEE NO_COMPU_METHOD 0 0 -3.40282346639E+38 3.40282346639E+38 ECU_ADDRESS 0x52801A98 /end MEASUREMENT
/begin CHARACTERISTIC VCU_Msg.VCU_RDrvControlMode "" VALUE 0x52801A08 __ULong_Value 0 NO_COMPU_METHOD 0 4294967295 /end CHARACTERISTIC
/begin CHARACTERISTIC VCU_Msg.VCU_RDrvRequesSpeed "" VALUE 0x52801A0C __Float32_Value 0 NO_COMPU_METHOD -3.40282346639E+38 3.40282346639E+38 /end CHARACTERISTIC
/begin CHARACTERISTIC VCU_Msg.VCU_RDrvRequestTorque "" VALUE 0x52801A04 __Float32_Value 0 NO_COMPU_METHOD -3.40282346639E+38 3.40282346639E+38 /end CHARACTERISTIC
/begin CHARACTERISTIC VCU_Msg.VCU_VehicleSts "" VALUE 0x52801A1C __ULong_Value 0 NO_COMPU_METHOD 0 4294967295 /end CHARACTERISTIC
/begin CHARACTERISTIC VCU_SpdloopTorLimitDn "" VALUE 0x52800E50 __Float32_Value 0 NO_COMPU_METHOD -3.40282346639E+38 3.40282346639E+38 /end CHARACTERISTIC
/begin CHARACTERISTIC VCU_SpdloopTorLimitUp "" VALUE 0x52800E4C __Float32_Value 0 NO_COMPU_METHOD -3.40282346639E+38 3.40282346639E+38 /end CHARACTERISTIC
/begin CHARACTERISTIC XCP_Calib_EnFlag "" VALUE 0x52800E5A __UByte_Value 0 NO_COMPU_METHOD 0 255 /end CHARACTERISTIC
/begin CHARACTERISTIC XCP_VCU_EnFlag "" VALUE 0x52800E59 __UByte_Value 0 NO_COMPU_METHOD 0 255 /end CHARACTERISTIC
/begin RECORD_LAYOUT __Float32_Value FNC_VALUES 1 FLOAT32_IEEE ROW_DIR DIRECT /end RECORD_LAYOUT
/begin RECORD_LAYOUT __UByte_Value FNC_VALUES 1 UBYTE ROW_DIR DIRECT /end RECORD_LAYOUT
/begin RECORD_LAYOUT __ULong_Value FNC_VALUES 1 ULONG ROW_DIR DIRECT /end RECORD_LAYOUT
/begin RECORD_LAYOUT __UWord_Value FNC_VALUES 1 UWORD ROW_DIR DIRECT /end RECORD_LAYOUT
/begin GROUP Calibration ""
 /begin REF_CHARACTERISTIC Cal_CurntCtrl_Ki_d Cal_CurntCtrl_Ki_q Cal_CurntCtrl_Kp_d Cal_CurntCtrl_Kp_q Cal_RslvOfst DebugCAN.CtrlMode DebugCAN.Enable DebugCAN.IsCMD DebugCAN.ThetaCMD /end REF_CHARACTERISTIC
/end GROUP
/begin GROUP MCUFaults ""
 /begin REF_MEASUREMENT ErrorCheck.Out_UT8_0NMFlag ErrorCheck.Out_UT8_ASCTFlag ErrorCheck.Out_UT8_DisIGBTFlag ErrorCheck.Out_UT8_ErrLevel ErrorCheck.Out_UT8_LimSpeedTorFlag ErrorCheck.Out_UT8_LimTorFlag /end REF_MEASUREMENT
 /begin SUB_GROUP MoF_COM MoF_MCS MoF_MotVoltsNCurr MoF_MotorStatus MoF_Other MoF_PCB MoF_Temperature /end SUB_GROUP
/end GROUP
/begin GROUP MCUstatus "" /begin SUB_GROUP MoSta_IdIq_Ctrl MoSta_Status MoSta_Temperature /end SUB_GROUP /end GROUP
/begin GROUP MoF_COM ""
 /begin REF_MEASUREMENT ErrorCheck.Out_U8_Can0B6LostMsgFault ErrorCheck.Out_U8_Can0B6TimeOutFault ErrorCheck.Out_U8_Can100InvalidFault ErrorCheck.Out_U8_Can100LostMsgFault ErrorCheck.Out_U8_Can100TimeOutFault ErrorCheck.Out_U8_Can1BusOffFault ErrorCheck.Out_U8_Can2BusOffFault /end REF_MEASUREMENT
/end GROUP
/begin GROUP MoF_MCS ""
 /begin REF_MEASUREMENT ErrorCheck.Out_U8_HWCurrPHOverFault ErrorCheck.Out_U8_HWDeadFault ErrorCheck.Out_U8_HWFoBFault ErrorCheck.Out_U8_HWFoTFault ErrorCheck.Out_U8_HWVoltLowerFault ErrorCheck.Out_U8_HWVoltOverFault /end REF_MEASUREMENT
/end GROUP
/begin GROUP MoF_MotVoltsNCurr ""
 /begin REF_MEASUREMENT ErrorCheck.Out_U8_CurrSenFaultAll ErrorCheck.Out_U8_CurrSenUPhFault ErrorCheck.Out_U8_CurrSenVPhFault ErrorCheck.Out_U8_CurrSenWPhFault ErrorCheck.Out_U8_SpdOverWarn ErrorCheck.Out_U8_VoltLowerWarn ErrorCheck.Out_U8_VoltOverFault ErrorCheck.Out_U8_VoltSuperLower ErrorCheck.Out_U8_VoltSuperOverFault ErrorCheck.Out_UT8_MultiOverCurrentFault /end REF_MEASUREMENT
/end GROUP
/begin GROUP MoF_MotorStatus ""
 /begin REF_MEASUREMENT ErrorCheck.Out_U8_BlockFault ErrorCheck.Out_U8_BlockWarn ErrorCheck.Out_U8_CrashFault ErrorCheck.Out_U8_VcuSpdCmdWarn ErrorCheck.Out_U8_VcuTroqCmdWarn ErrorCheck.Out_UT8_MotorTempWarnBeginLimit /end REF_MEASUREMENT
/end GROUP
/begin GROUP MoF_Other "" /begin REF_MEASUREMENT ErrorCheck.Out_U8_HWRdcFault ErrorCheck.Out_U8_OPFault /end REF_MEASUREMENT /end GROUP
/begin GROUP MoF_PCB ""
 /begin REF_MEASUREMENT ErrorCheck.Out_U8_12VLowerWarn ErrorCheck.Out_U8_12VOverWarn ErrorCheck.Out_U8_5VLowerWarn ErrorCheck.Out_U8_5VOverWarn ErrorCheck.Out_U8_DrvPBCCurrLowWarn ErrorCheck.Out_U8_DrvPBCCurrOverWarn ErrorCheck.Out_U8_VextsLowerWarn ErrorCheck.Out_U8_VextsOverWarn /end REF_MEASUREMENT
/end GROUP
/begin GROUP MoF_Temperature ""
 /begin REF_MEASUREMENT ErrorCheck.Out_U8_CoolerTempOverWarn ErrorCheck.Out_U8_CoolerTempSenorFault ErrorCheck.Out_U8_IgbtEstimTempOverWarn ErrorCheck.Out_U8_IgbtTemSenFaultAll ErrorCheck.Out_U8_IgbtTempOverWarn ErrorCheck.Out_U8_McuTempOverFault ErrorCheck.Out_U8_MotTemSenWarn ErrorCheck.Out_U8_MotTemSenWarnAll /end REF_MEASUREMENT
/end GROUP
/begin GROUP MoSta_IdIq_Ctrl ""
 /begin REF_MEASUREMENT AdcRealVal.V_DC CurntCtrl.Id_Fb CurntCtrl.Id_Ref CurntCtrl.Iq_Fb CurntCtrl.Iq_Ref CurntCtrl.UdFb CurntCtrl.UqFb CurntCtrl.UsOutFlt MtrCalib.IdSet MtrCalib.IqSet MtrCalib.ThtSetReal UserCAN0_TxMSG.RMCU_Us_Out /end REF_MEASUREMENT
/end GROUP
/begin GROUP MoSta_Status ""
 /begin REF_MEASUREMENT StateMachineStruct.Out_U16_State UserCAN0_TxMSG.RMCU_ActualTorqueFB UserCAN0_TxMSG.RMCU_DrvMotorRPM UserCAN0_TxMSG.RMCU_DrvMotorWorkSts UserCAN0_TxMSG.RMCU_MainWireVolt UserCAN0_TxMSG.RMCU_MaxTorqueAllow /end REF_MEASUREMENT
/end GROUP
/begin GROUP MoSta_Temperature ""
 /begin REF_MEASUREMENT UserCAN0_TxMSG.RMCU_DrvMotorInletTemp UserCAN0_TxMSG.RMCU_DrvMotorTemp UserCAN0_TxMSG.RMCU_Temp /end REF_MEASUREMENT
/end GROUP
/begin GROUP Test "" /begin REF_CHARACTERISTIC EventFrame.Switcher /end REF_CHARACTERISTIC
 /begin REF_MEASUREMENT ASW_Core0_1000ms_cnt ASW_Core0_100ms_cnt ASW_Core0_10ms_cnt ASW_Core0_1ms_cnt UserCAN0_TxMSG.RMCU_0CB_RollingCounter UserCAN0_TxMSG.RMCU_120_RollingCounter /end REF_MEASUREMENT
/end GROUP
/begin GROUP VCU ""
 /begin REF_CHARACTERISTIC TestID_Struct.Test_ID_7AF_Spdloop_Towing_Platform VCU_Msg.VCU_RDrvControlMode VCU_Msg.VCU_RDrvRequesSpeed VCU_Msg.VCU_RDrvRequestTorque VCU_Msg.VCU_VehicleSts VCU_SpdloopTorLimitDn VCU_SpdloopTorLimitUp /end REF_CHARACTERISTIC
/end GROUP
/end MODULE
/end PROJECT
